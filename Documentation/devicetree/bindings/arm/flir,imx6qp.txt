## Documentation/devicetree/bindings/arm/flir,imx6qp.txt
```
FLIR imx6qp

The FLIR Boards

Required properties:
- compatible: "fsl,imx6qp-ec702", "fsl,imx6qp-flir"

Example:
```

## Documentation/devicetree/bindings/display/boe,vx039x0m-nh0.yaml
```yaml
# SPDX-License-Identifier: (GPL-2.0-only OR BSD-2-Clause)
%YAML 1.2
---
$id: http://devicetree.org/schemas/display/boe,vx039x0m-nh0.yaml#
$schema: http://devicetree.org/meta-schemas/core.yaml#

title: BOE vx039x0m-nh0 viewfinder

maintainers:
  - Flir

properties:
  compatible:
    boe,vx039x0m-nh0

  ipu_id:
    description: which ipu to run on

  disp_id:
    description: which display interface to use

  default_ifmt:
    description: pixel format to use

  pinctrl-names:
    description: phandle to pin control of rgb interface, must be "default", "disabled"

  pinctrl-0:
    description: phandle to pinctrl, enabled

  pinctrl-1:
    description: phandle to pinctrl, disabled

  i2c_bus:
    description: i2c bus to which the display is connected

  i2c_addr:
    description: i2c address of the display

  power-supply:
    description: phandle to power supply regulator


required:
  - compatible
  - ipu_id
  - disp_id
  - default_ifmt
  - pinctrl-names
  - pinctrl-0
  - i2c_bus
  - i2c_addr

optional:
  - power-supply

additionalProperties: false

examples:
  - |
    lcd_i2c@0 {
      compatible = "boe,vx039x0m-nh0";
      ipu_id = <0>;
      disp_id = <0>;
      default_ifmt = "RGB24";
      pinctrl-names = "default", "disabled";
      pinctrl-0 = <&pinctrl_ipu1_di0_enabled>;
      pinctrl-1 = <&pinctrl_ipu1_di0_disabled>;
      i2c_bus = <0x00>;
      i2c_addr = <0x4c>;
      power-supply = <&reg_disp_pwr_en>;
      status = "okay";
    };

...
```

## Documentation/devicetree/bindings/iio/accel/flir,adxl344.yaml
```yaml
# SPDX-License-Identifier: (GPL-2.0 OR BSD-2-Clause)
%YAML 1.2
---
$id: http://devicetree.org/schemas/iio/accel/flir,adxl344.yaml#
$schema: http://devicetree.org/meta-schemas/core.yaml#

title: Analog Devices ADXL344 3-Axis Digital Accelerometers

maintainers:
  - Flir

description: |
  Analog Devices ADXL344 3-Axis Digital Accelerometers over I2C
    https://www.analog.com/en/products/mems/accelerometers/adxl344.html

properties:
  compatible:
    flir,adxl344

  reg:
    maxItems: 1

  axis_map_x:
    description: |
      Index for x axis remapping.
  axis_map_y:
    description: |
      Index for y axis remapping.
  axis_map_z:
    description: |
      Index for z axis remapping

  negate_x:
    description: |
      Invert x axis.
  negate_y:
    description: |
      Invert x axis.
  negate_z:
    description: |
      Invert x axis.

  is_sensor_accel:
    description: |
      Distinguish between sensor and LCD accelerometers.


required:
  - compatible
  - reg


additionalProperties: false

examples:
  - |
   accelerometer@1d {
		compatible = "flir,adxl344";
		reg = <0x1d>;
		axis-map-x = <0>;
		axis-map-y = <2>;
		axis-map-z = <1>;
		negate-y;
		is-sensor-accel; };
```

## Documentation/devicetree/bindings/input/rohm,bm1422.txt
```
* Rohm BM1422 magnetometer

Required properties:
	- compatible - One of:
		"rohm,bm1422" - BM1422
	- reg -  I2C slave address
	- axis-map-x
	- axis-map-y
	- axis-map-z

Optional properties:
	- negate-x
	- negate-y
	- negate-z

Example:

	  evlc4_mag_bm1422: evlc4_mag_bm1422@0F {
		compatible = "rohm,bm1422";
		reg = <0x0F>;
		// Remap axes for appcore
		axis-map-x = <2>; // X = -Z
		negate-x;
		axis-map-y = <0>; // Y = X
		axis-map-z = <1>; // Z = -Y
		negate-z;
	  };
```

## Documentation/devicetree/bindings/leds/backlight/flir,max5380.yaml
```yaml
# SPDX-License-Identifier: (GPL-2.0 OR BSD-2-Clause)
%YAML 1.2
---
$id: http://devicetree.org/schemas/leds/backlight/flir,max5380.yaml#
$schema: http://devicetree.org/meta-schemas/core.yaml#

title: Binding for Flir max5380 backlight

maintainers:
  - Flir

description: |
  max5380 driver is used for controlling backlight of the eMagin 100080 display
  with a max5380 dac controlling the VHB input of the eMagin 100080 display
properties:
  compatible:
    flir,max5830

  reg:
    maxItems: 1

  default-brightness:
    description: |
      brightness value on boot.

  max-brightness:
    description: |
      Maximum brightness level.

required:
  - compatible
  - reg

additionalProperties: false

examples:
  - |
    backlight: backlight_vf@30 {
      reg = <0x30>;
      compatible = "flir,max5380";
      default-brightness = <0x40>;
      max-brightness = <255>;
    };
```

## Documentation/devicetree/bindings/misc/flir,ema100080.yaml
```yaml
# SPDX-License-Identifier: GPL-2.0-only OR BSD-2-Clause
# Copyright (C) 2022 Flir Teledyne
%YAML 1.2
---
$id: http://devicetree.org/schemas/misc/flir,ema100080.yaml#
$schema: http://devicetree.org/meta-schemas/core.yaml#

title: eMagin lcd bindings

description: |
  This binding describes the flir implementation of eMagin 100080 on Flir
  platforms using a adv1723 converter from an lcd interface on host processor.

maintainers:
  - Flir Teledyne

properties:
  compatible:
    const: flir,ema100080

  eoco-fvm-psave-gpio:
    description: GPIO specifier for psave signal on adv1723
    maxItems: 1

  i2c-config-cmds:
    description: Command array in tuples of 2 bytes used to init ema 100080
                 Maximum 32 tuples (64 values)
    maxItems: 64

  reg:
    description: i2c address, 7bit, where the emagin 100080 resides

required:
  - compatible
  - eoco-fvm-psave-gpio
  - i2c-config-cmds

additionalProperties: false

examples:
  - |
    #include <dt-bindings/gpio/gpio.h>

    flir_ema100080: flir_ema100080@32 {
		compatible = "flir,ema100080";
		pinctrl-names = "default";
		pinctrl-0 = <&pinctrl_viewfinder>;

		eoco-fvm-psave-gpio = <&gpio4 17 GPIO_ACTIVE_HIGH>;

		reg = <0x32>;
		// These were taken from old ce driver. It is essentially SVGA_60, from page 45 in the eMagin 100080 datasheet
		// So this is the setup for the 800x600, this needs to match what is setup in mxc_lcdif (nxp code)
		i2c-config-cmds =	<0x01 0x80>, // Red Analog Input Gain
					<0x02 0x38>, // Red Analog Input DC Offset
					<0x03 0x80>, // Green Analog Input Gain
					<0x04 0x38>, // Green Analog Input DC Offset
					<0x05 0x80>, // Blue Analog Input Gain
					<0x06 0x38>, // Blue Analog Input DC Offset
					<0x07 0x80>, // Mono Analog Input Gain
					<0x08 0x38>, // Mono Analog Input DC Offset
					<0x09 0x00>, // Vertical Mode Settings (SVGA 600 rows, RGB)
					<0x0A 0x02>, // HMODE (SVGA 800 columns, internal PLL, no screen saver)
					<0x0D 0x00>, // HRATE_L (Horizontal Shift Frame Rate = 0x8000 (every 9 minute))
					<0x0E 0x80>, // HRATE_U
					<0x0F 0x1E>, // PLL_L (Feedback Divider=0x41E, Post-Scaler Divider=1)
					<0x10 0x0C>, // PLL_U
					<0x11 0x0C>, // PIF (Phase Interpolator Frequency = 40 MHz)
					<0x12 0x00>, // PI2 (Phase Adjustment)
					<0x13 0xD4>, // HSTART (Horizontal Active Start Count)
					<0x14 0x19>, // VSTART (Vertical Active Start Count)
					<0x15 0xD8>, // HBLK
					<0x16 0x0C>, // HDEL
					<0x17 0x02>, // PWDN (disable MONO analog input)
					<0x18 0x80>, // ATB (power control through PWDN register)
					<0x1A 0x00>; // TRIM (automatic and periodic calibration)
	};

...
```

## Documentation/devicetree/bindings/misc/flir,fvdk.txt
```
FLIR FVDK Driver

The fvdk driver supports fpga in FLIR cameras

Required properties:
- reg: address and length of the register for the device.
- compatible: "flir,fvd", "flir,fvdk"

Example:

	fvdk {
		compatible = "flir,fvd", "flir,fvdk";
		fpa-supply = <&reg_ec702_4v0_fpa>;
		1v1_fpga-supply = <&DA9063_BPRO>;
		1v2_fpga-supply = <&DA9063_PERI_SW>;
		1v8_fpga-supply = <&DA9063_CORE_SW>;
		2v5_fpga-supply = <&DA9063_BMEM>;
		3v15_fpga-supply = <&DA9063_LDO8>;

		pinctrl-names = "default", "spi-default", "spi-idle";
		pinctrl-0 = <&pinctrl_fvd>;
		pinctrl-1 = <&pinctrl_ecspi1>;
		pinctrl-2 = <&pinctrl_ecspi1_idle>;

		fpga_status_n = <&gpio1 2 GPIO_ACTIVE_LOW>;
		fpga_config_n = <&gpio1 7 GPIO_ACTIVE_LOW>;
		fpga_conf_done = <&gpio1 8 GPIO_ACTIVE_HIGH>;
		fpga_ce_n = <&gpio5 25 GPIO_ACTIVE_LOW>;
		fpga-ready-gpio = <&gpio3 19 GPIO_ACTIVE_HIGH>;

		spi-sclk-gpio = <&gpio5 22 GPIO_ACTIVE_HIGH>;
		spi-mosi-gpio = <&gpio5 23 GPIO_ACTIVE_HIGH>;
		spi-miso-gpio = <&gpio5 24 GPIO_ACTIVE_HIGH>;
		spi-cs-gpio = <&gpio5 28 GPIO_ACTIVE_LOW>;

		// The fvdk driver needs to find the SPI device
		// via this phandle to prepare flash during FPGA programming
		spi_fpga_flash = <&qspi_flash>;
	};
```

## drivers/power/supply/fusb30x/Kconfig
```kconfig
if POWER_SUPPLY

config POWER_SUPPLY_FUSB30X
       tristate "Fairchild FUSB30x Driver"
	help
	  Say Y here to enable FUSB30x USB type C PD negotiator
	  and drivers.

if POWER_SUPPLY_FUSB30X

   config POWER_SUPPLY_FUSB30X_DEBUG
   bool "Debug"
   help
	  Say Y here to enable Debugging of FUSB30x USB type C PD negotiator

   config POWER_SUPPLY_FUSB30X_TRIGGERED_INTERRUPT
   bool "Triggered Interrupt"
   help
	  Say Y here to enable Debugging of FUSB30x USB type C PD negotiator

   config POWER_SUPPLY_FUSB30X_SRC
   bool "Source"
   help
	  Say Y here to enable Debugging of FUSB30x USB type C PD negotiator
   config POWER_SUPPLY_FUSB30X_SNK
   bool "Sink"
   help
	  Say Y here to enable Debugging of FUSB30x USB type C PD negotiator
   config POWER_SUPPLY_FUSB30X_DRP
   bool "Dual role protocol"
   help
	  Say Y here to enable Debugging of FUSB30x USB type C PD negotiator
   config POWER_SUPPLY_FUSB30X_ACCMODE
   bool "Accessory mode"
   help
	  Say Y here to enable Debugging of FUSB30x USB type C PD negotiator
   config POWER_SUPPLY_FUSB30X_VDM
   bool "VDM"
   help
	  Say Y here to enable Debugging of FUSB30x USB type C PD negotiator
   config POWER_SUPPLY_FUSB30X_DP
   bool "Displayport"
   help
	  Say Y here to enable Debugging of FUSB30x USB type C PD negotiator



endif

endif # POWER_SUPPLY
```
