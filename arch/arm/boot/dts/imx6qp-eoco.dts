/*
 * Copyright 2022 FLIR Systems.
 *
 * The code contained herein is licensed under the GNU General Public
 * License. You may obtain a copy of the GNU General Public License
 * Version 2 or later at the following locations:
 *
 * http://www.opensource.org/licenses/gpl-license.html
 * http://www.gnu.org/copyleft/gpl.html
 */

/*This file should include the latest hw combination*/

/dts-v1/;

#include "imx6qp.dtsi"
#include "imx6qp-eoco.dtsi"

/ {
        model = "Teledyne FLIR i.MX6 Dual Plus eoco Board";
        compatible = "fsl,imx6qp-eoco", "fsl,imx6qp-flir", "fsl,imx6qp";
        chosen {
                bootargs = "console=ttymxc0,115200 earlyprintk";
        };
};
