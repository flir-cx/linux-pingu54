
/*
 * Copyright 2015 FLIR Systems.
 *
 * The code contained herein is licensed under the GNU General Public
 * License. You may obtain a copy of the GNU General Public License
 * Version 2 or later at the following locations:
 *
 * http://www.opensource.org/licenses/gpl-license.html
 * http://www.gnu.org/copyleft/gpl.html
 */

/*
 *
 * Changes IO pin for 4va regulator between EVIO and LECO board
 *
 */
/ {
	regulators{
		reg_4va_bw_en {
		       	gpio = <&leif_pca9534_0x46 7 GPIO_ACTIVE_HIGH>;
		};			
	};
  };
