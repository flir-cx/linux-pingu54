/*
 * Copyright 2015 FLIR Systems.
 *
 * The code contained herein is licensed under the GNU General Public
 * License. You may obtain a copy of the GNU General Public License
 * Version 2 or later at the following locations:
 *
 * http://www.opensource.org/licenses/gpl-license.html
 * http://www.gnu.org/copyleft/gpl.html
 */

/*This dts file represents ec101-e and leif-a and later*/

/dts-v1/;

#include "imx6dl.dtsi"
#include "imx6dl-leif.dtsi"
#include "imx6dl-ec101.dtsi"
#include "imx6dl-ec101-e.dtsi"
#include "imx6dl-evbw.dtsi"
#include "imx6dl-evbw-leco.dtsi"
#include "imx6dl-evro.dtsi"
#include "imx6dl-leif.dtsi"
#include "imx6dl-lesl.dtsi"
//#include "imx6dl-evlc2.dtsi"  //Lennox has EVLC2, but are not to use the Compass inside
#include "imx6dl-legp.dtsi"


/ {
        model = "FLIR i.MX6 Solo leco-ea Board";
        compatible = "fsl,imx6dl-leco", "fsl,imx6dl-ec101", "fsl,imx6dl-flir", "fsl,imx6dl";
        chosen {
                bootargs = "console=ttymxc0,115200 earlyprintk";
        };
};
