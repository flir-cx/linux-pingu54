/*
 * Copyright 2015 FLIR Systems.
 *
 * The code contained herein is licensed under the GNU General Public
 * License. You may obtain a copy of the GNU General Public License
 * Version 2 or later at the following locations:
 *
 * http://www.opensource.org/licenses/gpl-license.html
 * http://www.gnu.org/copyleft/gpl.html
 */

/*This file should include the latest hw combination*/

/dts-v1/;

#include "imx6dl.dtsi"
#include "imx6dl-detcal.dtsi"
#include "imx6dl-ec101.dtsi"
#include "imx6dl-ec101-d.dtsi"

/ {
        model = "FLIR i.MX6 Solo Detector Calibration Board";
        compatible = "fsl,imx6dl-detcal","fsl,imx6dl-ec101", "fsl,imx6dl-flir", "fsl,imx6dl";
        chosen {
                bootargs = "console=ttymxc0,115200 earlyprintk";
        };
};
